/*
 * Copyright (c) 2022 The ZMK Contributors
 *
 * SPDX-License-Identifier: MIT
 */

/**
 * Note: This PMW3610 is a serial interface, but using VIK SPI pins on this module. You *cannot* use
 * this module if the main keyboard or controller is already using SPI on the same channel.
 * You also need to define a special SPI interface. Look at the zmk-fingerpunch-controllers module in the vikoto controller
 * by searching for vik_spi_pmw3610 to see how it's defined. It uses the MISO pin for bidirectional communication
 * Also see the readme of the https://github.com/sadekbaroudi/zmk-pmw3610-driver repo for info asf well.
 */
&vik_spi_pmw3610 {
    status = "okay";
    cs-gpios = <&vik_conn 6 GPIO_ACTIVE_LOW>;

    trackball: trackball@0 {
        status = "okay";
        compatible = "pixart,pmw3610";
        reg = <0>;
        spi-max-frequency = <2000000>;
        irq-gpios = <&vik_conn 4 (GPIO_ACTIVE_LOW | GPIO_PULL_UP)>;

        /*   optional features   */
        // snipe-layers = <1>;
        // scroll-layers = <2 3>;
        // automouse-layer = <4>;
    };
};

/ {
    trackball_listener {
      compatible = "zmk,input-listener";
      device = <&trackball>;
  };
};