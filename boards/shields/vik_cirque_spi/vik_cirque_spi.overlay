/*
 * Copyright (c) 2022 The ZMK Contributors
 *
 * SPDX-License-Identifier: MIT
 */

&vik_spi {
    status = "okay";
    cs-gpios = VIK_SPI_CS_PREFIX_PROCESSED <&vik_conn 6 GPIO_ACTIVE_LOW>;
    
    glidepoint: glidepoint@VIK_SPI_REG_START {
        compatible = "cirque,pinnacle";
        reg = <VIK_SPI_REG_START>;
        spi-max-frequency = <1000000>;
        status = "okay";
        dr-gpios = <&vik_conn 5 (GPIO_ACTIVE_HIGH)>; // DR pin on cirque is always &vik_conn 5

        sensitivity = "4x";
        sleep;
        no-taps;
    };
};

/ {
    glidepoint_input {
        compatible = "zmk,input-listener";
        device = <&glidepoint>;

        // Options for cirque, to be defined in the keyboard shield
        // xy-swap;
        // y-invert;
        // x-invert;
    };
};