/*
 * Copyright (c) 2022 The ZMK Contributors
 *
 * SPDX-License-Identifier: MIT
 */

#include "../vik_shield_dts_preprocess.h"
#include <dt-bindings/zmk/input_transform.h>
#include <dt-bindings/input/input-event-codes.h>

// i2c cirque config for vikoto
// note that if you are using I2C with a controller with a vik connector directly on it (e.g. vikoto)
// you need to use the intenal pull up resistors on the board
// look in boards/arm/vikoto/vikoto-pinctrl.dtsi as an example
// look for "bias-pull-up;"
// generally recommend spi, as it doesn't require any custom configuration
&vik_i2c {
    status = "okay";
    
    glidepoint: glidepoint@2a {
        compatible = "cirque,pinnacle";
        reg = <0x2a>;
        status = "okay";
        dr-gpios = <&vik_conn 5 (GPIO_ACTIVE_HIGH)>; // DR pin on cirque is always &vik_conn 5

        sensitivity = "4x";
        sleep;
        no-taps;
    };
};

/ {
    glidepoint_input: glidepoint_input {
        compatible = "zmk,input-listener";
        device = <&glidepoint>;

        // Options for cirque, to be defined in the keyboard shield
        // input-processors = <&xy_transform (INPUT_TRANSFORM_XY_SWAP | INPUT_TRANSFORM_X_INVERT | INPUT_TRANSFORM_Y_INVERT) &xy_scaler 3 2>;
    };
};
