// if this is ever updated in the vikoto vik_connector.dtsi, this needs to be updated as well
&i2c1_default {
    group1 {
        bias-pull-up;
    };
};

&i2c1_sleep {
    group1 {
        bias-pull-up;
    };
};