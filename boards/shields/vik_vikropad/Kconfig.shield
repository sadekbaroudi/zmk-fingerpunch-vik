## boards/shields/vik_vikropad/Kconfig.shield
```kconfig
# Copyright (c) 2021 The ZMK Contributors
# SPDX-License-Identifier: MIT

config SHIELD_VIK_VIKROPAD
    def_bool $(shields_list_contains,vik_vikropad)
```

## dts/bindings/adc/sadekbaroudi,vik-adc.yaml
```yaml
# Copyright (C) 2019 Peter Bigot Consulting, LLC
# SPDX-License-Identifier: Apache-2.0

description: |
    ADC channels exposed on VIK connector.

    The VIK connector provides two Analog Input pins.

    This binding provides a nexus mapping for these pins where parent
    pins 0 and 1 correspond to "Digital/Analog GPIO 1" and
    "Digital/Analog GPIO 2", respectfully.

compatible: "sadekbaroudi,vik-adc"

include: base.yaml

properties:
    io-channel-map:
      type: compound
      required: true

    io-channel-map-mask:
      type: compound
      required: false

    io-channel-map-pass-thru:
      type: compound
      required: false

    "#io-channel-cells":
      type: int
      required: true
      description: Number of items to expect in an ADC specifier
```

## dts/bindings/gpio/sadekbaroudi,vik-connector.yaml
```yaml
# Copyright (c) 2023 Pete Johanson
# SPDX-License-Identifier: MIT

description: |
    GPIO pins exposed on VIK connectors.

    The VIK interface offers 9 GPIO pins, with all but two also specified
    for alternate functions, such as SPI, I2C, etc.

    Proceeding from pin 1 on a VIK controller:
    * 3.3v
    * GND
    * SDA
    * SCL
    * RGB Data Out 
    * 5V
    * Digital/Analog GPIO 1
    * COPI
    * Digital/Analog GPIO 2
    * CS
    * CIPO
    * SCLK

    This binding provides a nexus mapping for 9 pins, as depicted below:

        - 3V3
        - GND
        0 SDA
        1 SCL
        2 RGB Data Out
        - 5V
        3 Digital/Analog GPIO 1
        4 COPI
        5 Digital/Analog GPIO 2
        6 CS
        7 CIPO
        8 SCLK


compatible: "sadekbaroudi,vik-connector"

include: [gpio-nexus.yaml, base.yaml]
```
