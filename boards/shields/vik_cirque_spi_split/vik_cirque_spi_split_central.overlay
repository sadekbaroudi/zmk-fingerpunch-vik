/*
 * Copyright (c) 2022 The ZMK Contributors
 *
 * SPDX-License-Identifier: MIT
 */

#include "../vik_shield_dts_preprocess.h"
#include "vik_cirque_spi_split.dtsi"

#include <dt-bindings/zmk/input_transform.h>
#include <dt-bindings/input/input-event-codes.h>

&glidepoint_listener {
    status = "okay";
};
